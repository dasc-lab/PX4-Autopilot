## src/modules/geometric_control/Kconfig
```kconfig
menuconfig MODULES_GEOMETRIC_CONTROL
	bool "geometric_control"
	default n
	---help---
		Enable support for geometric_control

menuconfig USER_GEOMETRIC_CONTROL
	bool "geometric_control running as userspace module"
	default n
	depends on BOARD_PROTECTED && MODULES_GEOMETRIC_CONTROL
	---help---
		Put geometric_control in userspace memory
```

## src/modules/indi_att_control/Kconfig
```kconfig
menuconfig MODULES_INDI_ATT_CONTROL
	bool "indi_att_control"
	default n
	---help---
		Enable support for indi_att_control

menuconfig USER_INDI_ATT_CONTROL
	bool "indi_att_control running as userspace module"
	default n
	depends on BOARD_PROTECTED && MODULES_INDI_ATT_CONTROL
	---help---
		Put indi_att_control in userspace memory
```

## src/modules/indi_control/Kconfig
```kconfig
menuconfig MODULES_INDI_POS_CONTROL
	bool "indi_pos_control"
	default n
	---help---
		Enable support for indi_pos_control

menuconfig USER_INDI_POS_CONTROL
	bool "indi_pos_control running as userspace module"
	default y
	depends on BOARD_PROTECTED && MODULES_INDI_POS_CONTROL
	---help---
		Put indi_pos_control in userspace memory
```

## src/modules/indi_rate_control/Kconfig
```kconfig
menuconfig MODULES_INDI_RATE_CONTROL
	bool "indi_rate_control"
	default n
	---help---
		Enable support for indi_rate_control

menuconfig USER_INDI_RATE_CONTROL
	bool "indi_rate_control running as userspace module"
	default n
	depends on BOARD_PROTECTED && MODULES_INDI_RATE_CONTROL
	---help---
		Put indi_rate_control in userspace memory
```

## src/modules/quad_control/Kconfig
```kconfig
menuconfig MODULES_QUAD_CONTROL
  bool "quad_control"
  default n
  ---help---
      Enable quadrotor control

menuconfig USER_QUAD_CONTROL
  bool "quad_control running as userspace module"
  default y
  depends on BOARD_PROTECTED && MODULES_QUAD_CONTROL
  ---help---
    Put quad_control in userspace memory  
```

## src/modules/simple_commander/Kconfig
```kconfig
menuconfig MODULES_SIMPLE_COMMANDER
	bool "simple_commander"
	default n
	---help---
		Enable support for simple commander

menuconfig USER_SIMPLE_COMMANDER
	bool "simple_commander running as userspace module"
	default y
	depends on BOARD_PROTECTED && MODULES_SIMPLE_COMMANDER
	---help---
		Put simple_commander in userspace memory
```
